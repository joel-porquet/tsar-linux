/*
 * DTS file for TSARV5 monocpu on FPGA
 */

/dts-v1/;

/include/ "skeleton_fpga.dtsi"
/include/ "cpu_mono.dtsi"
/include/ "freq_fpga_de2.dtsi"

/ {
	model = "UPMC/LIP6/SoC - Tsar v5 monocpu FPGA";
	compatible = "tsar,v5_fpga", "tsar,monocpu_v5_fpga";

	chosen {
		/* the day we have a uart8250 compatible component, we can use
		 * the earlycon param to get earlyprintk */
		/* bootargs = "earlycon=uart8250,mmio,0x00000000"; */

		/* this is for maximum debug */
		/* bootargs = "ignore_loglevel initcall_debug"; */

		/* display console in both framebuffer and tty (the last one
		 * becomes the default one) */
		bootargs = "console=tty0 console=ttyVTTY0 earlyprintk";
	};
};


