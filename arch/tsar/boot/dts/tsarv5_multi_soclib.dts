/*
 * DTS file for TSARV5 multicpu on SoCLib
 */

/dts-v1/;

/include/ "skeleton_soclib.dtsi"
/include/ "cpu_multi.dtsi"
/include/ "freq_soclib.dtsi"

/ {
	model = "UPMC/LIP6/SoC - Tsar v5 multicpu SoCLib";
	compatible = "tsar,v5_soclib", "tsar,multicpu_v5_soclib";

	chosen {
		/* the day we have a uart8250 compatible component, we can use
		 * the earlycon param to get earlyprintk */
		/* bootargs = "earlycon=uart8250,mmio,0x00000000"; */

		/* this is for maximum debug */
		/* bootargs = "ignore_loglevel initcall_debug"; */

		/* display console in both framebuffer and tty (the last one
		 * becomes the default one) */
		bootargs = "console=tty0 console=ttyVTTY0 earlyprintk";
	};
};
