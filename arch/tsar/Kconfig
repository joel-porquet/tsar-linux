## arch/tsar/Kconfig
```kconfig
##
# Default configuration tokens
##

config TSAR
	def_bool y
	select ARCH_WANT_FRAME_POINTERS
	select ARCH_DISCARD_MEMBLOCK
	select CLKSRC_OF
	select CLONE_BACKWARDS # position of tls in clone syscall
	select COMMON_CLK
	select GENERIC_ATOMIC64
	select GENERIC_CLOCKEVENTS
	select GENERIC_CPU_DEVICES
	select GENERIC_IRQ_PROBE
	select GENERIC_IRQ_SHOW
	select GENERIC_IOMAP
	select GENERIC_SMP_IDLE_THREAD
	select GENERIC_STRNCPY_FROM_USER
	select GENERIC_STRNLEN_USER
	#select HAVE_ARCH_JUMP_LABEL # should we implement this? see "mips/kernel/jump_label.c"
	select HAVE_ARCH_TRACEHOOK # user_regset_view API in ptrace
	select HAVE_ARCH_KGDB
	select HAVE_MEMBLOCK
	select HAVE_MEMBLOCK_NODE_MAP
	select IRQ_DOMAIN
	select MODULES_USE_ELF_REL if MODULES
	select NO_BOOTMEM
	select OF
	select OF_EARLY_FLATTREE

config LOCKDEP_SUPPORT
	def_bool y

config STACKTRACE_SUPPORT
	def_bool y

config MMU
	def_bool y

config ARCH_PHYS_ADDR_T_64BIT
	def_bool y

config ARCH_DMA_ADDR_T_64BIT
	def_bool y

config NO_DMA
	# XXX: no DMA for now
	bool
	default y

config RWSEM_GENERIC_SPINLOCK
	def_bool y

config GENERIC_HWEIGHT
	def_bool y

config GENERIC_CALIBRATE_DELAY
	def_bool y

source "init/Kconfig"

source "kernel/Kconfig.freezer"

##
# System choice
##

menu "Processor/system type and features"

choice
	prompt "TSAR system type"
	default ARCH_TSARV5_MONO_SOCLIB

config ARCH_TSARV4_MONO_SOCLIB
	bool "Tsar monocpu v4 soclib"
	select TSAR_V4
	select TSAR_SOCLIB

config ARCH_TSARV5_MONO_SOCLIB
	bool "Tsar monocpu v5 soclib"
	select TSAR_V5
	select TSAR_SOCLIB

config ARCH_TSARV5_MULTI_SOCLIB
	bool "Tsar multicpu v5 soclib"
	select SMP
	select TSAR_V5
	select TSAR_SOCLIB

config ARCH_TSARV5_MONO_FPGA
	bool "Tsar monocpu v5 fpga"
	select TSAR_V5
	select TSAR_FPGA

config ARCH_TSARV5_MULTI_FPGA
	bool "Tsar multicpu v5 fpga"
	select SMP
	select TSAR_V5
	select TSAR_FPGA

config ARCH_TSARV5_LETI_SOCLIB
	bool "Tsar leti v5 soclib"
	select SMP
	select TSAR_V5
	select TSAR_SOCLIB
	select TSAR_LETI

config ARCH_TSARV5_LETI_FPGA
	bool "Tsar leti v5 fpga"
	select SMP
	select TSAR_V5
	select TSAR_FPGA
	select TSAR_LETI

endchoice

##
# Multi-processor and NUMA related tokens
##

config SMP
	bool "Symmetric multi-processing support"

config NR_CPUS
	int "Maximum number of CPUs"
	range 2 4 if SMP && !TSAR_MULTI_CLUSTER
	range 2 256 if SMP && TSAR_MULTI_CLUSTER
	depends on SMP
	default "1" if !SMP
	default "4" if SMP && !TSAR_MULTI_CLUSTER
	default "256" if SMP && TSAR_MULTI_CLUSTER

config NUMA
	bool "NUMA support"
	depends on TSAR_MULTI_CLUSTER

config NODES_SHIFT
	int "Maximum NUMA nodes (as a power of 2)"
	range 1 8
	default "1"
	depends on NEED_MULTIPLE_NODES # enabled by NUMA

config USE_PERCPU_NUMA_NODE_ID
	def_bool y
	depends on NUMA

config SMP_IPI_BOOT
	bool
	depends on SMP

config TSAR_L1_CACHE_SHIFT
	int "Size of L1 cache line (as a power of 2)"
	default 6

config PAGE_OFFSET
	hex "User/kernel split address"
	default 0xC0000000

##
# System type: soclib (simulation), fpga, LETI
##

config TSAR_SOCLIB
	bool

config TSAR_FPGA
	bool
	select SMP_IPI_BOOT if SMP

config TSAR_LETI
	bool
	select SOCLIB_VCI_XICU_LETI
	select SMP_IPI_BOOT
	select TSAR_MULTI_CLUSTER

##
# Devices
##

config SOCLIB_VCI_ICU
	bool
	help
		ICU is a memory mapped device which implements a simple
		vectorized interrupt controller.
		<http://www.soclib.fr/trac/dev/wiki/Component/VciIcu>

config SOCLIB_VCI_XICU
	bool
	help
		XICU is a memory mapped device, implementing:
		- a vectorized interrupt controller,
		- a timer controller,
		- an IPI controller.
		<http://www.soclib.fr/trac/dev/wiki/Component/VciXicu>

config SOCLIB_VCI_XICU_HWI
	bool
	default y
	depends on SOCLIB_VCI_XICU
	help
		Enables XICUs to be connected to local devices and thus receive
		hardware interrupts (HWI). Otherwise XICUs can only get timer
		and software-triggered interrupts (PTI and WTI). The latter is
		perfectly valid and sufficient when using an IOPIC for
		transmitting interrupts from devices.

config SOCLIB_VCI_XICU_CPUIRQS_SHIFT
	int "Number of irq output lines connected to a cpu (as a power of 2)"
	range 0 2
	default "0" if !TSAR_LETI
	default "2" if TSAR_LETI
	depends on SOCLIB_VCI_XICU
	help
		In the LETI system, ranges of 4 output lines from a XICU are
		connected to a same processor (range 0-3 to local processor 0,
		range 4-7 to local processor 1, etc.). In most other systems,
		there is only one output line per processor.

config SOCLIB_VCI_MTTY
	bool
	help
		Multi-TTY device.
		<http://www.soclib.fr/trac/dev/wiki/Component/VciMultiTty>

config SOCLIB_VCI_TIMER
	bool
	select CLKSRC_MMIO
	help
		Multi-timer device.
		<http://www.soclib.fr/trac/dev/wiki/Component/VciMultiTimer>

config SOCLIB_VCI_IOC
	bool
	help
		Block device.
		<http://www.soclib.fr/trac/dev/wiki/Component/VciBlockDevice>

##
# TSAR versions: v4 (obsolete), v5
##

config TSAR_V4
	bool
	select SOCLIB_VCI_ICU
	select SOCLIB_VCI_TIMER
	select SOCLIB_VCI_IOC
	select SOCLIB_VCI_MTTY

config TSAR_V5
	bool
	select SOCLIB_VCI_XICU
	select SOCLIB_VCI_IOC
	select SOCLIB_VCI_MTTY

config TSAR_MULTI_CLUSTER
	bool
	select ARCH_DISCONTIGMEM_ENABLE
	select NUMA
	select SPARSE_IRQ

config ARCH_DISCONTIGMEM_ENABLE
	bool

config HIGHMEM
	bool "High memory support"
	default y
	help
		On 32-bit systems, the kernel is only able to map 896MiB worth
		of memory. Enable this option to access and use memory above
		this limit.

config HIGHPTE
	bool "Allocate page tables in highmem"
	depends on HIGHMEM
	default y
	help
		Setting this option will put user-space page tables (PTE2) in
		high memory, to avoid wasting low memory.

source "mm/Kconfig"

config MATH_EMULATION
	def_bool n

config PHYSICAL_START
	hex "Physical address where the kernel is loaded"
	default 0x1000
	help
	  This gives the physical address where the kernel is loaded.
	  Default is to leave one 4KiB free page.

source "kernel/Kconfig.hz"
source "kernel/Kconfig.preempt"

endmenu

menu "Executable file formats"

source "fs/Kconfig.binfmt"

endmenu

source "net/Kconfig"

source "drivers/Kconfig"

source "fs/Kconfig"

source "arch/tsar/Kconfig.debug"

source "security/Kconfig"

source "crypto/Kconfig"

source "lib/Kconfig"
```

## arch/tsar/Kconfig.debug
```kconfig
menu "Kernel hacking"

config TRACE_IRQFLAGS_SUPPORT
	bool
	default y

source "lib/Kconfig.debug"

config EARLY_PRINTK
	bool "Early printk" if EXPERT
	default y
	help
	  This option enables special console drivers which allow the kernel
	  to print messages very early in the bootup process.

endmenu
```

## arch/tsar/configs/tsar_monocpu_soclib_defconfig
```kconfig
CONFIG_BLK_DEV_INITRD=y
CONFIG_HZ_100=y
# CONFIG_COMPACTION is not set
CONFIG_KERNEL_LZMA=y
# CONFIG_SWAP is not set
CONFIG_TINY_RCU=y
CONFIG_EXPERT=y
# CONFIG_SUSPEND is not set
# CONFIG_INPUT is not set
# CONFIG_SERIO is not set
# CONFIG_VT is not set
# CONFIG_LEGACY_PTYS is not set
# CONFIG_HWMON is not set
# CONFIG_USB_SUPPORT is not set
# CONFIG_IOMMU_SUPPORT is not set
# CONFIG_MISC_FILESYSTEMS is not set
CONFIG_DEBUG_FS=y
CONFIG_DEBUG_KERNEL=y
CONFIG_DEBUG_INFO=y
# CONFIG_DEBUG_INFO_REDUCED is not set
CONFIG_DEBUG_MEMORY_INIT=y
#CONFIG_DYNAMIC_DEBUG=y
```

## arch/tsar/configs/tsar_multicpu_soclib_defconfig
```kconfig
CONFIG_ARCH_TSAR_MULTI_SOCLIB=y
CONFIG_BLK_DEV_INITRD=y
# CONFIG_RD_GZIP is not set
CONFIG_NO_HZ_IDLE=y
CONFIG_HIGH_RES_TIMERS=y
# CONFIG_COMPACTION is not set
CONFIG_KERNEL_LZMA=y
# CONFIG_SWAP is not set
CONFIG_TINY_RCU=y
CONFIG_EXPERT=y
# CONFIG_SUSPEND is not set
# CONFIG_INPUT_MOUSEDEV is not set
# CONFIG_INPUT_KEYBOARD is not set
# CONFIG_INPUT_MOUSE is not set
# CONFIG_SERIO is not set
CONFIG_VT=y
# CONFIG_LEGACY_PTYS is not set
# CONFIG_HWMON is not set
CONFIG_FB=y
CONFIG_FB_SIMPLE=y
# CONFIG_VGA_CONSOLE is not set
CONFIG_FRAMEBUFFER_CONSOLE=y
CONFIG_LOGO=y
# CONFIG_HID is not set
# CONFIG_USB_SUPPORT is not set
# CONFIG_IOMMU_SUPPORT is not set
# CONFIG_MISC_FILESYSTEMS is not set
CONFIG_DEBUG_FS=y
CONFIG_DEBUG_KERNEL=y
CONFIG_DEBUG_INFO=y
# CONFIG_DEBUG_INFO_REDUCED is not set
CONFIG_DEBUG_MEMORY_INIT=y
#CONFIG_DYNAMIC_DEBUG=y
```
